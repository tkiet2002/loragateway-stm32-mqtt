/*
 * oled.c
 *
 *  Created on: Nov 21, 2024
 *      Author: khoav
 */
#include "main.h"
#include "oled.h"

const uint8_t font5x7[][5] = { { 0x00, 0x00, 0x00, 0x00, 0x00 }, // Space (32)
		{ 0x00, 0x00, 0x5F, 0x00, 0x00 }, // ! (33)
		{ 0x00, 0x07, 0x00, 0x07, 0x00 }, // " (34)
		{ 0x14, 0x7F, 0x14, 0x7F, 0x14 }, // # (35)
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		{ 0x02, 0x01, 0x02, 0x04, 0x02 }, // ~ (126)
		};

const uint8_t font8x16[] = {
//    240,248,12,4,4,12,248,240,63,63,2,2,2,2,63,63, //A

		0x00, 0x00, 0x00, 0x00, 0x00, 0x00, 0x00, 0x00, 0x00, 0x00, 0x00, 0x00,
		0x00, 0x00, 0x00,
		0x00, //   0
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		0x00, 0x00, 0x00, 0x00, // ~ 94
		};

uint8_t data[2] = { 0x40, 0 };
uint8_t cmd[2] = { 0x00, 0 };

char OLED_I2C_ADDRESS = 0x3c;
uint8_t current_x = 0, current_y = 0;
void oled_send_command(unsigned char command) {
	cmd[1] = command;
	HAL_I2C_Master_Transmit(&hi2c1, OLED_I2C_ADDRESS << 1, cmd, 2,
	HAL_MAX_DELAY);
}

void oled_send_data(unsigned char dt) {
	data[1] = dt;
	HAL_I2C_Master_Transmit(&hi2c1, OLED_I2C_ADDRESS << 1, data, 2,
	HAL_MAX_DELAY);
}

void oled_init() {
	oled_send_command(0xAE); // T?t màn hình (Display OFF)
	oled_send_command(0xD5); // Cài ??t Clock divide ratio
	oled_send_command(0x80); // Giá tr? m?c ??nh
	oled_send_command(0xA8); // Cài ??t MUX ratio
	oled_send_command(0x3F); // 1/64 duty
	oled_send_command(0xD3); // Cài ??t Display Offset
	oled_send_command(0x00); // Không d?ch chuy?n
	oled_send_command(0x40); // Set Display Start Line thành 0
	oled_send_command(0x8D); // B?t ngu?n c?p ?i?n áp DC
	oled_send_command(0x14); // B?t ?i?n áp
	oled_send_command(0xA1); // ??o chi?u quét ngang (Segment Re-map)
	oled_send_command(0xC8); // ??o chi?u quét d?c (COM Output Scan Direction)
	oled_send_command(0xDA); // Cài ??t COM pins hardware configuration
	oled_send_command(0x12);
	oled_send_command(0x81); // Cài ??t ?? t??ng ph?n
	oled_send_command(0xff);
	oled_send_command(0xD9); // Cài ??t Pre-charge Period
	oled_send_command(0xF1);
	oled_send_command(0xDB); // Cài ??t VCOMH Deselect Level
	oled_send_command(0x40);
	oled_send_command(0xA4); // Hi?n th? toàn b? RAM
	oled_send_command(0xA6); // Ch? ?? hi?n th? bình th??ng
	oled_send_command(0xAF); // B?t màn hình (Display ON)
}

void oled_display_pattern() {
	for (unsigned char page = 0; page < 8; page++) {
		oled_send_command(0xB0 + page); // Ch?n trang
		oled_send_command(0x00); // C?t th?p
		oled_send_command(0x10); // C?t cao

		for (unsigned char col = 0; col < 128; col++) {
			oled_send_data(0); // Tô ??y d? li?u (?en toàn màn hình)
		}
	}
}

void oled_display_char(unsigned char c) {
	// N?u ký t? n?m ngoài b?ng ASCII (t? 32 ??n 127), ta b? qua
	if (c < 32 || c > 127) {
		c = 32; // Ký t? kho?ng tr?ng n?u ngoài ph?m vi
	}

	// L?y ký t? t? b?ng font và g?i lên OLED
	for (unsigned char i = 0; i < 5; i++) {
		oled_send_data(font5x7[c - 32][i]); // Tr? 32 vì font b?t ??u t? ASCII 32
	}

	// Thêm kho?ng tr?ng gi?a các ký t?
	oled_send_data(0x00);
}

void oled_set_cursor(unsigned char x, unsigned char y) {
	current_x = x;
	current_y = y;
	oled_send_command(0xB0 + y);         // ??t dòng (y) cho màn hình OLED
	oled_send_command((x & 0x0F));       // ??t c?t th?p 4 bit (x)
	oled_send_command(0x10 + (x >> 4));  // ??t c?t cao 4 bit (x)
}

void ssd1306_char_f8x16(unsigned char ch) {
	if (ch < 32 || ch > 127) {
		ch = 32;
	}
	uint8_t c, i;
	c = ch - 32;
	for (i = 0; i < 8; i++) {
		oled_send_data(font8x16[(16 * c) + i]);
		current_x++;
	}

	current_x = current_x - 8;
	current_y++;
	oled_set_cursor(current_x, current_y);

	for (i = 0; i < 8; i++) {
		oled_send_data(font8x16[(16 * c) + i + 8]);
		current_x++;
	}
	current_x++;
	current_y--;
	oled_set_cursor(current_x, current_y);
}

void oled_display_string(const char *str) {
	while (*str) {
		ssd1306_char_f8x16(*str++);
	}
}

